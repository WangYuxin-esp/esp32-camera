
#include "sdkconfig.h"
// #ifdef CONFIG_C2399_SUPPORT   // cmyu add;

#include <stdint.h>
#include <stdlib.h>
#include <string.h>
#include "sccb.h"
#include "freertos/FreeRTOS.h"
#include "freertos/task.h"
#include "c2399.h"
#include "c2399_settings.h"

#if defined(ARDUINO_ARCH_ESP32) && defined(CONFIG_ARDUHAL_ESP_LOG)
#include "esp32-hal-log.h"
#else
#include "esp_log.h"
static const char *TAG = "c2399";
#endif

//#define REG_DEBUG_ON

static  uint16_t default_regs_xvga[][2] = {
/********************1024*768 5fps***************************************/
{0x3288,0x50},
{0x0401,0x3b},
{0x0403,0x00},
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{0x3c01,0x13},
//{0x3087,0x30},
{0x3087,0x34},
{0x3584,0x02},
{0x3108,0xef},
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{0x0202,0x02},
//{0x0203,0x50},
{0x3584,0x22},
//{0x3009,0x05},
{0x022d,0x1f},
{0x0101,0x01},

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{0x300b,0x10},


//AEC/AWB
{0x3082,0x00},
{0x3083,0x0a},
//{0x3084,0x80},
{0x3084,0x40},
//{0x3087,0xf0},
{0x3087,0x34},
{0x3f10,0x10},
//{0x3f10,0x11
//{0x3f04,0x07
//{0x3f05,0x80
//{0x3f06,0x04
//{0x3f07,0x38
//{0x3f8c,0x00},//awb},off
{0x3f8c,0x32},//awb},on

//dvp
{0x0303,0x01},
{0x0309,0x20},
{0x0307,0x3c},
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{0x00,  0x00},
};

static  uint16_t default_regs_720p[][2] = {
/********************720p 5fps**********************************/
{0x3288,0x50},//tm
{0x0401,0x3b},
{0x0403,0x00},
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{0x0202,0x02},
//{0x0203,0x50},
{0x3584,0x22},
//{0x3009,0x05},
{0x022d,0x1f},
{0x0101,0x01},

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{0x300b,0x10},


//AEC/AWB
{0x3082,0x00},
{0x3083,0x0a},
{0x3084,0x40},
//{0x3087,0xf0},
{0x3087,0x34},
{0x3089,0x10},
{0x3f10,0x10},
//{0x3f10,0x11
//{0x3f04,0x07
//{0x3f05,0x80
//{0x3f06,0x04
//{0x3f07,0x38
//{0x3f8c,0x00},
{0x3f8c,0x32},

//dvp
{0x0303,0x01},
{0x0309,0x20},
{0x0307,0x3c},
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{0x00,  0x00},
};

static  uint16_t default_regs_vga[][2] = {
/********************640*480 25fps***************************************/
{0x3288,0x50},//tm
{0x0401,0x3b},
{0x0403,0x00},
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{0x0202,0x02},
//{0x0203,0x50},
{0x3584,0x22},
{0x3009,0x05},
{0x022d,0x1f},
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{0x0343,0xbc},

//AEC/AWB
{0x3082,0x00},
{0x3083,0x0a},
{0x3084,0x40},
//{0x3087,0xf0},
{0x3087,0x34},
{0x3089,0x10},
{0x3f10,0x10},//avg}ROI}off

//dvp
{0x0303,0x00},
{0x0309,0x20},
{0x0307,0x52},
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{0x0304,0x0d},
//{0x0304,0x09},
{0x0305,0x01},
{0x0307,0x56},

//{0x3C00,0x04},
{0x3880,0x00},
{0x3881,0x18},
{0x3882,0x01},
{0x3883,0x53},
{0x3980,0x80},
{0x3f8c,0x32},
//{0x3C00,0x04},

{0x0100,0x01},//stream}on
{0x00,  0x00},
};


static  uint16_t default_regs_1080p[][2] = {
{0x3288,0x50},//tm
{0x0401,0x3b},
{0x0403,0x00},
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{0x3584,0x22},
//{0x3009,0x05},
{0x022d,0x1f},
{0x0101,0x01},

//{0x0304,0x08},
{0x0304,0x0c},
{0x0305,0x01},
{0x0340,0x05},
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{0x300b,0x10},


//AEC/AWB
{0x3082,0x00},
{0x3083,0x0a},
{0x3084,0x40},
//{0x3087,0xf0},
{0x3087,0x34},
{0x3089,0x10},
{0x3f10,0x10},//avg},ROI},off
//avg},ROI},on
//{0x3f10,0x11
//{0x3f04,0x07
//{0x3f05,0x80
//{0x3f06,0x04
//{0x3f07,0x38
//{0x3f8c,0x00},//awb},off
{0x3f8c,0x32},//awb},on

//dvp
{0x0303,0x01},
{0x0309,0x20},
{0x0307,0x3c},
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{0x00,  0x00},

};
static  uint16_t default_regs_270p[][2] = {
{0x3288,0x50},//tm
{0x0401,0x3b},
{0x0403,0x00},
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{0x3883,0x53},
//AEC/AWB
{0x3082,0x00},
{0x3083,0x0a},
{0x3084,0x40},//},light},target
{0x3087,0x34},
{0x3089,0x10},//{0x1c},again},controlled},by},reg3293/32a9
{0x3f10,0x10}, //ROI},off
//avg},ROI},on
//{0x3f10,0x11
//{0x3f04,0x07
//{0x3f05,0x80
//{0x3f06,0x04
//{0x3f07,0x38
//{0x3f8c,0x00},//awb},off
{0x3f8c,0x32},//awb},on

//dvp
{0x0303,0x00},
{0x0305,0x02},
{0x0309,0x20},
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{0x0202,0x02},
//{0x0203,0xff},
{0x3584,0x26},
{0x3980,0x80},

{0x0100,0x01},//stream},on
{0x00,  0x00},

};
static  uint16_t default_regs_540p[][2] = {
{0x3288,0x50},//tm
{0x0401,0x3b},
{0x0403,0x00},
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{0x3883,0x53},
//AEC/AWB
{0x3082,0x00},
{0x3083,0x0a},
{0x3084,0x40},//},light},target
{0x3087,0x34},
{0x3089,0x10},
{0x3f10,0x10}, //ROI},off
//{0x3f10,0x11
//{0x3f04,0x07
//{0x3f05,0x80
//{0x3f06,0x04
//{0x3f07,0x38
//{0x3f8c,0x00},//awb},off
{0x3f8c,0x32},//awb},on

//dvp
{0x0303,0x00},
{0x0305,0x02},
{0x0309,0x20},
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{0x0202,0x02},
//{0x0203,0xff},
{0x3584,0x22},

{0x3980,0x80},
{0x0100,0x01},//stream},on
{0x00,  0x00},
};
static int read_reg(uint8_t slv_addr, const uint16_t reg){
    int ret = SCCB_Read16(slv_addr, reg);
#ifdef REG_DEBUG_ON
    if (ret < 0) {
        ESP_LOGE(TAG, "READ REG 0x%04x FAILED: %d", reg, ret);
    }
#endif
    return ret;
}

static int check_reg_mask(uint8_t slv_addr, uint16_t reg, uint8_t mask){
    return (read_reg(slv_addr, reg) & mask) == mask;
}

static int read_reg16(uint8_t slv_addr, const uint16_t reg){
    int ret = 0, ret2 = 0;
    ret = read_reg(slv_addr, reg);
    if (ret >= 0) {
        ret = (ret & 0xFF) << 8;
        ret2 = read_reg(slv_addr, reg+1);
        if (ret2 < 0) {
            ret = ret2;
        } else {
            ret |= ret2 & 0xFF;
        }
    }
    return ret;
}


static int write_reg(uint8_t slv_addr, const uint16_t reg, uint8_t value){
    int ret = 0;
#ifndef REG_DEBUG_ON
    ret = SCCB_Write16(slv_addr, reg, value);
#else
    int old_value = read_reg(slv_addr, reg);
    if (old_value < 0) {
        return old_value;
    }
    if ((uint8_t)old_value != value) {
        ESP_LOGI(TAG, "NEW REG 0x%04x: 0x%02x to 0x%02x", reg, (uint8_t)old_value, value);
        ret = SCCB_Write16(slv_addr, reg, value);
    } else {
        ESP_LOGD(TAG, "OLD REG 0x%04x: 0x%02x", reg, (uint8_t)old_value);
        ret = SCCB_Write16(slv_addr, reg, value);//maybe not?
    }
    if (ret < 0) {
        ESP_LOGE(TAG, "WRITE REG 0x%04x FAILED: %d", reg, ret);
    }
#endif
    return ret;
}

static int set_reg_bits(uint8_t slv_addr, uint16_t reg, uint8_t offset, uint8_t mask, uint8_t value)
{
    int ret = 0;
    uint8_t c_value, new_value;
    ret = read_reg(slv_addr, reg);
    if(ret < 0) {
        return ret;
    }
    c_value = ret;
    new_value = (c_value & ~(mask << offset)) | ((value & mask) << offset);
    ret = write_reg(slv_addr, reg, new_value);
    return ret;
}

static int write_reg16(uint8_t slv_addr, const uint16_t reg, uint16_t value)
{
    if (write_reg(slv_addr, reg, value >> 8) || write_reg(slv_addr, reg + 1, value)) {
        return -1;
    }
    return 0;
}

static int write_reg32(uint8_t slv_addr, const uint16_t reg, uint32_t value)
{
    if (write_reg(slv_addr, reg, value >> 24) || write_reg(slv_addr, reg + 1, value >> 16)
		|| write_reg(slv_addr, reg + 2, value >> 8) || write_reg(slv_addr, reg + 3, value)) {
        return -1;
    }
    return 0;
}


static int write_regs(uint8_t slv_addr, const uint16_t (*regs)[2])
{
    int i = 0, ret = 0;
    while (!ret && regs[i][0] != REGLIST_TAIL) {
        if (regs[i][0] == REG_DLY) {
            vTaskDelay(regs[i][1] / portTICK_PERIOD_MS);
        } else {
            ret = write_reg16(slv_addr, regs[i][0], regs[i][1]);
        }
        i++;
    }
    return ret;
}



static int write_addr_reg(uint8_t slv_addr, const uint16_t reg, uint16_t x_value, uint16_t y_value)
{
    if (write_reg16(slv_addr, reg, x_value) || write_reg16(slv_addr, reg + 2, y_value)) {
        return -1;
    }
    return 0;
}

#define write_reg_bits(slv_addr, reg, mask, enable) set_reg_bits(slv_addr, reg, 0, mask, enable?mask:0)

int calc_sysclk(int xclk, bool pll_bypass, int pll_multiplier, int pll_sys_div, int pll_pre_div, bool pll_root_2x, int pll_seld5, bool pclk_manual, int pclk_div)
{
    
        ESP_LOGE(TAG, "-----------------calc_sysclk enter--------------------\n");
	/*const int pll_pre_div2x_map[] = { 2, 3, 4, 6 };//values are multiplied by two to avoid floats
    const int pll_seld52x_map[] = { 2, 2, 4, 5 };

    if(!pll_sys_div) {
        pll_sys_div = 1;
    }

    int pll_pre_div2x = pll_pre_div2x_map[pll_pre_div];
    int pll_root_div = pll_root_2x?2:1;
    int pll_seld52x = pll_seld52x_map[pll_seld5];

    int VCO = (xclk / 1000) * pll_multiplier * pll_root_div * 2 / pll_pre_div2x;
    int PLLCLK = pll_bypass?(xclk):(VCO * 1000 * 2 / pll_sys_div / pll_seld52x);
    int PCLK = PLLCLK / 2 / ((pclk_manual && pclk_div)?pclk_div:1);
    int SYSCLK = PLLCLK / 4;

    ESP_LOGD(TAG, "Calculated VCO: %d Hz, PLLCLK: %d Hz, SYSCLK: %d Hz, PCLK: %d Hz", VCO*1000, PLLCLK, SYSCLK, PCLK);
    return SYSCLK;
}

static int set_pll(sensor_t *sensor, bool bypass, uint8_t multiplier, uint8_t sys_div, uint8_t pre_div, bool root_2x, uint8_t seld5, bool pclk_manual, uint8_t pclk_div){
    int ret = 0;
    if(multiplier > 31 || sys_div > 15 || pre_div > 3 || pclk_div > 31 || seld5 > 3){
        ESP_LOGE(TAG, "Invalid arguments");
        return -1;
    }

    calc_sysclk(sensor->xclk_freq_hz, bypass, multiplier, sys_div, pre_div, root_2x, seld5, pclk_manual, pclk_div);

    ret = write_reg(sensor->slv_addr, SC_PLLS_CTRL0, bypass?0x80:0x00);
    if (ret == 0) {
        ret = write_reg(sensor->slv_addr, SC_PLLS_CTRL1, multiplier & 0x1f);
    }
    if (ret == 0) {
        ret = write_reg(sensor->slv_addr, SC_PLLS_CTRL2, 0x10 | (sys_div & 0x0f));
    }
    if (ret == 0) {
        ret = write_reg(sensor->slv_addr, SC_PLLS_CTRL3, (pre_div & 0x3) << 4 | seld5 | (root_2x?0x40:0x00));
    }
    if (ret == 0) {
        ret = write_reg(sensor->slv_addr, PCLK_RATIO, pclk_div & 0x1f);
    }
    if (ret == 0) {
        ret = write_reg(sensor->slv_addr, VFIFO_CTRL0C, pclk_manual?0x22:0x20);
    }
    if(ret){
        ESP_LOGE(TAG, "set_sensor_pll FAILED!");
    }
    return ret;*/
    return 0;
}

static int set_ae_level(sensor_t *sensor, int level);
static void set_ae_gamma(sensor_t *sensor)
{
	write_reg16(sensor->slv_addr, 0x326C, 0x1119); // APERTURE_PARAMETERS_2D
	write_reg16(sensor->slv_addr, 0x098E, 0xC930); // CAM_LL_START_DEMOSAIC
	write_reg(sensor->slv_addr, 0xC930, 0x08); // CAM_LL_START_DEMOSAIC
	write_reg(sensor->slv_addr, 0xC933, 0x08); // CAM_LL_STOP_DEMOSAIC
	write_reg(sensor->slv_addr, 0xC936, 0x0C); // CAM_LL_START_NR_RED
	write_reg(sensor->slv_addr, 0xC937, 0x0C); // CAM_LL_START_NR_GREEN
	write_reg(sensor->slv_addr, 0xC938, 0x0C); // CAM_LL_START_NR_BLUE
	write_reg(sensor->slv_addr, 0xC939, 0x0C); // CAM_LL_START_NR_THRESH
	write_reg(sensor->slv_addr, 0xC93A, 0x40); // CAM_LL_STOP_NR_RED
	write_reg(sensor->slv_addr, 0xC93B, 0x40); // CAM_LL_STOP_NR_GREEN
	write_reg(sensor->slv_addr, 0xC93C, 0x40); // CAM_LL_STOP_NR_BLUE
	write_reg(sensor->slv_addr, 0xC93D, 0x40); // CAM_LL_STOP_NR_THRESH
	write_reg16(sensor->slv_addr, 0xC95D, 0x24); // RESERVED_CAM_15D
	write_reg(sensor->slv_addr, 0xC970, 0x00); // CAM_OUTPUT_Y_OFFSET
	write_reg16(sensor->slv_addr, 0x337E, 0x0000); // RESERVED_SOC1_337E
	write_reg(sensor->slv_addr, 0xC92D, 0x00); // CAM_LL_END_SATURATION
	write_reg(sensor->slv_addr, 0xBC0A, 0x00); // LL_GAMMA_CONTRAST_CURVE_0
	write_reg(sensor->slv_addr, 0xBC0B, 0x14); // LL_GAMMA_CONTRAST_CURVE_1
	write_reg(sensor->slv_addr, 0xBC0C, 0x20); // LL_GAMMA_CONTRAST_CURVE_2
	write_reg(sensor->slv_addr, 0xBC0D, 0x35); // LL_GAMMA_CONTRAST_CURVE_3
	write_reg(sensor->slv_addr, 0xBC0E, 0x58); // LL_GAMMA_CONTRAST_CURVE_4
	write_reg(sensor->slv_addr, 0xBC0F, 0x75); // LL_GAMMA_CONTRAST_CURVE_5
	write_reg(sensor->slv_addr, 0xBC10, 0x8E); // LL_GAMMA_CONTRAST_CURVE_6
	write_reg(sensor->slv_addr, 0xBC11, 0xA3); // LL_GAMMA_CONTRAST_CURVE_7
	write_reg(sensor->slv_addr, 0xBC12, 0xB5); // LL_GAMMA_CONTRAST_CURVE_8
	write_reg(sensor->slv_addr, 0xBC13, 0xC5); // LL_GAMMA_CONTRAST_CURVE_9
	write_reg(sensor->slv_addr, 0xBC14, 0xD3); // LL_GAMMA_CONTRAST_CURVE_10
	write_reg(sensor->slv_addr, 0xBC15, 0xDD); // LL_GAMMA_CONTRAST_CURVE_11
	write_reg(sensor->slv_addr, 0xBC16, 0xE6); // LL_GAMMA_CONTRAST_CURVE_12
	write_reg(sensor->slv_addr, 0xBC17, 0xED); // LL_GAMMA_CONTRAST_CURVE_13
	write_reg(sensor->slv_addr, 0xBC18, 0xF2); // LL_GAMMA_CONTRAST_CURVE_14
	write_reg(sensor->slv_addr, 0xBC19, 0xF6); // LL_GAMMA_CONTRAST_CURVE_15
	write_reg(sensor->slv_addr, 0xBC1A, 0xF9); // LL_GAMMA_CONTRAST_CURVE_16
	write_reg(sensor->slv_addr, 0xBC1B, 0xFC); // LL_GAMMA_CONTRAST_CURVE_17
	write_reg(sensor->slv_addr, 0xBC1C, 0xFF); // LL_GAMMA_CONTRAST_CURVE_18
	write_reg(sensor->slv_addr, 0xBC1D, 0x00); // LL_GAMMA_NRCURVE_0
	write_reg(sensor->slv_addr, 0xBC1E, 0x18); // LL_GAMMA_NRCURVE_1
	write_reg(sensor->slv_addr, 0xBC1F, 0x25); // LL_GAMMA_NRCURVE_2
	write_reg(sensor->slv_addr, 0xBC20, 0x3A); // LL_GAMMA_NRCURVE_3
	write_reg(sensor->slv_addr, 0xBC21, 0x59); // LL_GAMMA_NRCURVE_4
	write_reg(sensor->slv_addr, 0xBC22, 0x70); // LL_GAMMA_NRCURVE_5
	write_reg(sensor->slv_addr, 0xBC23, 0x81); // LL_GAMMA_NRCURVE_6
	write_reg(sensor->slv_addr, 0xBC24, 0x90); // LL_GAMMA_NRCURVE_7
	write_reg(sensor->slv_addr, 0xBC25, 0x9E); // LL_GAMMA_NRCURVE_8
	write_reg(sensor->slv_addr, 0xBC26, 0xAB); // LL_GAMMA_NRCURVE_9
	write_reg(sensor->slv_addr, 0xBC27, 0xB6); // LL_GAMMA_NRCURVE_10
	write_reg(sensor->slv_addr, 0xBC28, 0xC1); // LL_GAMMA_NRCURVE_11
	write_reg(sensor->slv_addr, 0xBC29, 0xCB); // LL_GAMMA_NRCURVE_12
	write_reg(sensor->slv_addr, 0xBC2A, 0xD5); // LL_GAMMA_NRCURVE_13
	write_reg(sensor->slv_addr, 0xBC2B, 0xDE); // LL_GAMMA_NRCURVE_14
	write_reg(sensor->slv_addr, 0xBC2C, 0xE7); // LL_GAMMA_NRCURVE_15
	write_reg(sensor->slv_addr, 0xBC2D, 0xEF); // LL_GAMMA_NRCURVE_16
	write_reg(sensor->slv_addr, 0xBC2E, 0xF7); // LL_GAMMA_NRCURVE_17
	write_reg(sensor->slv_addr, 0xBC2F, 0xFF); // LL_GAMMA_NRCURVE_18
	write_reg(sensor->slv_addr, 0xB00C, 0x00); // BLACKLEVEL_MAX_BLACK_LEVEL
	write_reg16(sensor->slv_addr, 0xC960, 0x0000); // CAM_PGA_PGA_CONTROL
	write_reg(sensor->slv_addr, 0xC86C, 0x04); // CAM_AET_AEMODE
	write_reg(sensor->slv_addr, 0xC86E, 0x10); // CAM_AET_TARGET_AVERAGE_LUMA
	write_reg(sensor->slv_addr, 0xC86F, 0x05); // CAM_AET_TARGET_AVERAGE_LUMA_DARK
	write_reg16(sensor->slv_addr, 0xC954, 0x20); // cam_ll_start_target_luma_bm
	write_reg16(sensor->slv_addr, 0xC956, 0x100); // cam_ll_stop_target_luma_bm
	write_reg16(sensor->slv_addr, 0xC950, 0x1400); // CAM_LL_CLUSTER_DC_TH_BM
	write_reg16(sensor->slv_addr,0xFC00, 0x2800);
    write_reg16(sensor->slv_addr,0x0040, 0x8100);
    write_reg16(sensor->slv_addr,0x0040, 0x8101);
	write_reg(sensor->slv_addr, 0xA806, 0x01);
	//write_reg(sensor->slv_addr, 0xC86E, 0x28);
	//write_reg(sensor->slv_addr, 0xC86F, 0x28);
}

static int reset(sensor_t *sensor)
{
     int i=0;
	int ret;
    const uint16_t (*regs)[2];

    ESP_LOGE(TAG, "-----------------c2399 reset enter--------------------\n");
    // Write default regsiters
    for (i=0, regs = default_regs_540p; regs[i][0]; i++) {
		ret = write_reg(sensor->slv_addr, regs[i][0], regs[i][1]);
		//ESP_LOGE(TAG, "-----------------c2399 write_reg32 ret = %d--------------------\n",ret);
		vTaskDelay(10 / portTICK_PERIOD_MS);
    }
    vTaskDelay(10 / portTICK_PERIOD_MS);
	ret = SCCB_Read16(sensor->slv_addr, 0x3980);
		ESP_LOGE(TAG, "-----------------c2399 read_reg16 0x3980,value = %02x--------------------\n",ret);
    return 0;
}

static int set_pixformat(sensor_t *sensor, pixformat_t pixformat)
{
    return 0;
}

static int set_image_options(sensor_t *sensor)
{
    return 0;
}

static int write_framesize_regs(sensor_t *sensor,  uint16_t (*regs)[2])
{
        int ret = 0;
        for (int i=0; regs[i][0]; i++) {
		    ret = write_reg(sensor->slv_addr, regs[i][0], regs[i][1]);
		    //ESP_LOGE(TAG, "-----------------c2399 write_reg32 ret = %d--------------------\n",ret);
		    vTaskDelay(10 / portTICK_PERIOD_MS);
        }
        return ret;
}

static int set_framesize(sensor_t *sensor, framesize_t framesize)
{
	 int ret=0;
	  // return 0;
        ESP_LOGE(TAG, "set_framesize enter+++++++++++++++++++++++++++");
        if(framesize == FRAMESIZE_VGA)//640*480
            ret = write_framesize_regs(sensor,default_regs_vga);
        else if(framesize == FRAMESIZE_XGA)//1024*768
            ret = write_framesize_regs(sensor,default_regs_xvga);
        else if(framesize == FRAMESIZE_HD)//1280*720
            ret = write_framesize_regs(sensor,default_regs_720p);
        else if(framesize == FRAMESIZE_FHD)//1280*720
            {ESP_LOGE(TAG, "set_framesize enter+++++++++++++++++++++++++++begint to init 1080p");
            ret = write_framesize_regs(sensor,default_regs_1080p);}
        //else if(framesize == FRAMESIZE_270P)//
         //   ret = write_framesize_regs(sensor,default_regs_270p);
        else if(framesize == FRAMESIZE_SVGA_USER)//
            ret = write_framesize_regs(sensor,default_regs_540p);
       return ret;
}

// cmyu add for +ZREG at cmd;    // ZZESP32MCU-15
static int write_regsArray(uint16_t (*regs)[2], const uint16_t reg, uint8_t value)
{
    int ret = 0;
    for (int i=0; regs[i][0]; i++) {
        if(regs[i][0] == reg)
        {
            regs[i][1] = value;
            break;
        }
    }
    return ret;
}

// ZZESP32MCU-15
int write_all_regsArray(const uint16_t reg, uint8_t value)
{
     write_regsArray(default_regs_vga, reg, value);   //640*480
     
     write_regsArray(default_regs_xvga, reg, value);  //1024*768
     
     write_regsArray(default_regs_720p, reg, value);   //1280*720
     
     write_regsArray(default_regs_1080p, reg, value);  // 1920*1280
     
     write_regsArray(default_regs_540p, reg, value);    //
     
     write_regsArray(default_regs_270p, reg, value);   //
     
     return 0;
}

static int set_hmirror(sensor_t *sensor, int enable)
{
	return 0;
}

static int set_vflip(sensor_t *sensor, int enable)
{
	return 0;
}

static int set_quality(sensor_t *sensor, int qs)
{
    return 0;
}

static int set_colorbar(sensor_t *sensor, int enable)
{
    return 0;
}

static int set_A_gain(sensor_t *sensor, uint16_t gain)
{
	return 0;
}

static int set_global_gain(sensor_t *sensor, uint16_t gain)
{
	return 0;
}

static int set_gain_ctrl(sensor_t *sensor, int enable)
{
	return 0;
}

static int set_exposure_ctrl(sensor_t *sensor, int enable)
{
    int ret = 0;
    ESP_LOGE(TAG, "Set exposure_ctrl,enable = %d",enable );
    if(enable)
	    ret = write_reg(sensor->slv_addr, 0x3087, 0x30);
    else
	    ret = write_reg(sensor->slv_addr, 0x3087, 0xf0);    
    return ret;
}

static int set_whitebal(sensor_t *sensor, int enable)
{
    return 0;
}

//Advanced AWB
static int set_dcw_dsp(sensor_t *sensor, int enable)
{
    return 0;
}

//night mode enable
static int set_aec2(sensor_t *sensor, int enable)
{
    return 0;
}

static int set_bpc_dsp(sensor_t *sensor, int enable)
{
    return 0;
}

static int set_wpc_dsp(sensor_t *sensor, int enable)
{
    return 0;
}

//Gamma enable
static int set_raw_gma_dsp(sensor_t *sensor, int enable)
{
    return 0;
}

static int set_lenc_dsp(sensor_t *sensor, int enable)
{
    return 0;
}

static int get_agc_gain(sensor_t *sensor)
{
    return 0;
}

//real gain
static int set_agc_gain(sensor_t *sensor, int gain)
{
    return 0;
}

static int get_aec_value(sensor_t *sensor)
{
    return 0;
}

static int set_aec_value(sensor_t *sensor, int value)
{
    int ret = 0;
    uint8_t exposure_l = 0;
    uint8_t exposure_h = 0;
    if (value < 0 || value > 0xffff) {
        ESP_LOGE(TAG, " aec_value is error");
        return -1;
    }
     
	exposure_l = (uint8_t)(value & 0xFF);
	exposure_h = (uint8_t)((value>>8) & 0xFF);

    ESP_LOGE(TAG, "set_aec_value,exposure_l = %02x,exposure_h = %02x", exposure_l,exposure_h);

	ret = write_reg(sensor->slv_addr, 0x0202, exposure_h);
	ret = write_reg(sensor->slv_addr, 0x0203, exposure_l);
    return ret;

}

static int set_ae_level(sensor_t *sensor, int level)
{
    return 0;
}

static int set_wb_mode(sensor_t *sensor, int mode)
{
    return 0;
}

static int set_awb_gain_dsp(sensor_t *sensor, int enable)
{
    return 0;
}

static int set_special_effect(sensor_t *sensor, int effect)
{
    return 0;
}

static int set_brightness(sensor_t *sensor, int level)
{
	return 0;
}

static int set_contrast(sensor_t *sensor, int level)
{
    return 0;
}

static int set_saturation(sensor_t *sensor, int level)
{
    return 0;
}

static int set_sharpness(sensor_t *sensor, int level)
{
    return 0;
}

static int set_gainceiling(sensor_t *sensor, gainceiling_t level)
{
    return 0;
}

static int get_denoise(sensor_t *sensor)
{
    return 0;
}

static int set_denoise(sensor_t *sensor, int level)
{
    return 0;
}

static int init_status(sensor_t *sensor)
{
    return 0;
}

int c2399_init(sensor_t *sensor)
{
    sensor->reset = reset;
    sensor->set_pixformat = set_pixformat;
    sensor->set_framesize = set_framesize;
    sensor->set_contrast = set_contrast;
    sensor->set_brightness = set_brightness;
    sensor->set_saturation = set_saturation;
    sensor->set_sharpness = set_sharpness;
    sensor->set_gainceiling = set_gainceiling;
    sensor->set_quality = set_quality;
    sensor->set_colorbar = set_colorbar;
    sensor->set_gain_ctrl = set_gain_ctrl;
    sensor->set_exposure_ctrl = set_exposure_ctrl;
    sensor->set_whitebal = set_whitebal;
    sensor->set_hmirror = set_hmirror;
    sensor->set_vflip = set_vflip;
    sensor->init_status = init_status;
    sensor->set_aec2 = set_aec2;
    sensor->set_aec_value = set_aec_value;
    sensor->set_special_effect = set_special_effect;
    sensor->set_wb_mode = set_wb_mode;
    sensor->set_ae_level = set_ae_level;
    sensor->set_dcw = set_dcw_dsp;
    sensor->set_bpc = set_bpc_dsp;
    sensor->set_wpc = set_wpc_dsp;
    sensor->set_awb_gain = set_awb_gain_dsp;
    sensor->set_agc_gain = set_agc_gain;
    sensor->set_raw_gma = set_raw_gma_dsp;
    sensor->set_lenc = set_lenc_dsp;
    sensor->set_denoise = set_denoise;
    return 0;
}

// cmyu add for writing sensor registers.
int set_register(sensor_t *sensor, const uint16_t reg, uint8_t value)
{
    int ret = 0;
    
    ret = write_reg(sensor->slv_addr, reg, value);    
    
    return ret;
}

uint8_t get_register(sensor_t *sensor, const uint16_t reg)
{
    int old_value = read_reg(sensor->slv_addr, reg);
    return (uint8_t)old_value;
}

int c2399_detect(int slv_addr, sensor_id_t *id)
{
    if (C2399_SCCB_ADDR == slv_addr) {
        uint8_t MIDH = SCCB_Read16(slv_addr, 0x0000);
        uint8_t MIDL = SCCB_Read16(slv_addr, 0x0001);
        uint16_t PID = MIDH << 8 | MIDL;
        if (C2399_PID == PID) {
            id->PID = PID;
            return PID;
        } else {
            ESP_LOGI(TAG, "Mismatch PID=0x%x", PID);
        }
    }
    return 0;
}
// #endif